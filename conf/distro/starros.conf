## conf/distro/starros.conf
```bitbake
DISTRO = "starros"
DISTRO_NAME = "StarRos (Easy to use and focus on ROS2)"
DISTRO_VERSION = "1.0"
DISTRO_CODENAME = "Hebei"
SDK_VENDOR = "-starrossdk"
SDK_VERSION = "${@d.getVar('DISTRO_VERSION').replace('snapshot-${METADATA_REVISION}', 'snapshot')}"
SDK_VERSION[vardepvalue] = "${SDK_VERSION}"

MAINTAINER = "StarROS <starros.ch@gmail.com>"

TARGET_VENDOR = "-starros"

LOCALCONF_VERSION = "2"

HAPPY_DEFAULT_DISTRO_FEATURES = "opengl ptest multiarch wayland vulkan pulseaudio vfat zeroconf nfs ldconfig alsa"
HAPPY_DEFAULT_EXTRA_RDEPENDS = "packagegroup-core-boot"
HAPPY_DEFAULT_EXTRA_RRECOMMENDS = "kernel-module-af-packet"

DISTRO_FEATURES ?= "${DISTRO_FEATURES_DEFAULT} ${HAPPY_DEFAULT_DISTRO_FEATURES}"

PREFERRED_VERSION_linux-yocto ?= "6.6%"
PREFERRED_VERSION_linux-yocto-rt ?= "6.6%"

SDK_NAME = "${DISTRO}-${TCLIBC}-${SDKMACHINE}-${IMAGE_BASENAME}-${TUNE_PKGARCH}-${MACHINE}"
SDKPATHINSTALL = "/opt/${DISTRO}/${SDK_VERSION}"

DISTRO_EXTRA_RDEPENDS += "${HAPPY_DEFAULT_EXTRA_RDEPENDS}"
DISTRO_EXTRA_RRECOMMENDS += "${HAPPY_DEFAULT_EXTRA_RRECOMMENDS}"

TCLIBCAPPEND = ""

PACKAGE_CLASSES ?= "package_deb"

SANITY_TESTED_DISTROS ?= " \
            poky-4.3 \n \
            poky-5.0 \n \
            ubuntu-20.04 \n \
            ubuntu-22.04 \n \
            ubuntu-23.04 \n \
            ubuntu-24.04 \n \
            fedora-38 \n \
            fedora-39 \n \
            fedora-40 \n \
            centosstream-8 \n \
            debian-11 \n \
            debian-12 \n \
            opensuseleap-15.4 \n \
            almalinux-8.8 \n \
            almalinux-8.9 \n \
            almalinux-8.10 \n \
            almalinux-9.2 \n \
            almalinux-9.4 \n \
            rocky-9 \n \
            "
# add poky sanity bbclass
INHERIT += "poky-sanity"

# QA check settings - a little stricter than the OE-Core defaults
# (none currently necessary as we now match OE-Core)
#WARN_TO_ERROR_QA = "X"
#WARN_QA_remove = "${WARN_TO_ERROR_QA}"
#ERROR_QA_append = " ${WARN_TO_ERROR_QA}"

require conf/distro/include/poky-world-exclude.inc
require conf/distro/include/no-static-libs.inc
require conf/distro/include/yocto-uninative.inc
require conf/distro/include/security_flags.inc
INHERIT += "uninative"

BB_SIGNATURE_HANDLER ?= "OEEquivHash"
BB_HASHSERVE ??= "auto"

POKY_INIT_MANAGER = "sysvinit"
INIT_MANAGER ?= "${POKY_INIT_MANAGER}"

# We need debug symbols so that SPDX license manifests for the kernel work
KERNEL_EXTRA_FEATURES:append = " features/debug/debug-kernel.scc"

# Enable creation of SPDX manifests by default
INHERIT += "create-spdx"


#---------------------------------------------------------------------------
VIRTUAL-RUNTIME_graphical_init_manager = "lxdm"

IMAGE_FEATURES:append = " \
        debug-tweaks dev-pkgs \
        tools-sdk package-management \
        hwcodecs nfs-server \
        ssh-server-openssh \
"
LICENSE_FLAGS_ACCEPTED:append = " commercial"
DISTRO_FEATURES:append = " x11 opengl"
DISTRO_FEATURES:append = " nfs ldconfig gobject-introspection-data zeroconf polkit"
DISTRO_FEATURES:remove = "wayland"
IMAGE_FSTYPES:append = " wic ext4"

PREFERRED_PROVIDER_virtual/xserver ?= "xserver-xorg"
XSERVER ?= " \
        xserver-xorg \
        xf86-video-modesetting \
        xserver-xorg-module-exa \
        xserver-xorg-extension-glx \
"
```
